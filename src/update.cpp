// Updates from an upload or a download: images and update files (update.h, spec 048).
#include "update.h"
#include <ESP8266WebServer.h>
#include <LittleFS.h>
#include <Updater.h>
#include <new>
#include "firmware_validation.h"
#define BUNDLE_TEXT(s) PSTR(s)   // the reader's messages stay in flash
#include "update_bundle.h"
#include "files_hash.h"   // FILES_HASH, generated by scripts/build_options.py

extern ESP8266WebServer server;
extern bool storageReady, recoveryMode;
bool requestAuthorized();
void safeRestart();

namespace {
const char STAGE[] = "/sys.new", LIVE[] = "/sys", MANIFEST[] = "/sys/manifest";
constexpr uint32_t FREE_MARGIN = 16 * 1024;   // storage left free beside the files

// The image check's 4.1 KB is allocated when an update starts and freed when it ends:
// only an update needs it (spec 025).
FirmwareValidation* firmware = nullptr;
BundleReader* bundle = nullptr;
File out;
String names[BundleReader::MAX_FILES];
uint8_t staged = 0;
bool active = false, started = false, failed = false, first = true, skipFiles = false;
uint32_t received = 0;
String error, note;
enum Files : uint8_t { FILES_UNMOUNTED, FILES_MISSING, FILES_STALE, FILES_OK } files = FILES_UNMOUNTED;

void release() {
  delete firmware; firmware = nullptr;
  delete bundle; bundle = nullptr;
  if (out) out.close();
}

// Removes what an unfinished update left in /sys.new.
void clearStage() {
  if (!storageReady) return;
  String found[BundleReader::MAX_FILES + 4];
  int n = 0;
  Dir d = LittleFS.openDir(STAGE);
  while (n < (int)(sizeof(found) / sizeof(found[0])) && d.next()) found[n++] = d.fileName();
  for (int i = 0; i < n; ++i) LittleFS.remove(String(STAGE) + '/' + found[i]);
  LittleFS.rmdir(STAGE);
}

// The image part, as the upload handler took it before spec 048. A byte is always
// withheld, so a failed check can never commit an image (Update.end(false)).
bool imageFeed(const uint8_t* data, size_t size) {
  if (!started) {
    // The first byte says how many the check needs: 28 (.bin.gz) or 4120 (plain).
    if (!firmware->received && size) { firmware->consume(data, 1); ++data; --size; }
    size_t len = firmware->prefixLen();
    size_t take = std::min(size, len - firmware->received);
    firmware->consume(data, take);
    data += take; size -= take;
    if (firmware->noMemory) { updateFail(F("Not enough memory for an update: try again")); return false; }
    if (firmware->received < len) return true;
    uint32_t freeSpace = ESP.getFreeSketchSpace();
    size_t capacity = freeSpace > 0x1000 ? (freeSpace - 0x1000) & 0xfffff000 : 0;
    if (const char* why = firmware->check(capacity, FS_PHYS_ADDR)) { updateFail(why); return false; }
    if (!Update.begin(firmware->expectedSize, U_FLASH)) { updateFail(F("Cannot stage firmware")); return false; }
    started = true;
    if (Update.write(const_cast<uint8_t*>(firmware->prefix()), len - 1) != len - 1) {
      updateFail(F("Firmware staging failed")); return false;
    }
    firmware->release();   // a plain image's 4 KB: staged now
  }
  if (!size) return true;
  if (size > firmware->expectedSize - firmware->received) { updateFail(F("Image exceeds declared length")); return false; }
  uint8_t previous = firmware->lastByte;
  firmware->consume(data, size);
  if (Update.write(&previous, 1) != 1 ||
      (size > 1 && Update.write(const_cast<uint8_t*>(data), size - 1) != size - 1)) {
    updateFail(F("Firmware staging failed")); return false;
  }
  return true;
}

// The update file's events: files to /sys.new, then the image.
bool bundleFeed(const uint8_t* p, size_t n) {
  while (n || bundle->pending()) {
    BundleReader::Event ev;
    size_t used = bundle->next(p, n, ev);
    p += used; n -= used;
    switch (ev) {
      case BundleReader::FAILED: updateFail(String(FPSTR(bundle->error))); return false;
      case BundleReader::FILE_START: {
        if (skipFiles) break;
        FSInfo fs;
        if (!LittleFS.info(fs) || fs.totalBytes - fs.usedBytes < bundle->size + FREE_MARGIN) {
          updateFail(F("Storage is full: delete photos to make room for the update")); return false;
        }
        LittleFS.mkdir(STAGE);
        out = LittleFS.open(String(STAGE) + '/' + bundle->name, "w");
        if (!out) { updateFail(F("Could not write the update's files")); return false; }
        names[staged++] = bundle->name;
        break;
      }
      case BundleReader::FILE_DATA:
        if (out && out.write(bundle->data, bundle->len) != bundle->len) { updateFail(F("Could not write the update's files")); return false; }
        break;
      case BundleReader::FILE_END:
        if (out) out.close();
        break;
      case BundleReader::IMAGE:
        if (!imageFeed(bundle->data, bundle->len)) return false;
        break;
      case BundleReader::NONE:
        if (!used) return true;
        break;
    }
  }
  return true;
}

// After the image is committed: the staged files replace /sys's, the manifest last. A
// power cut on the way leaves no manifest: the firmware shows its setup page until the
// update file is installed again.
bool installFiles() {
  LittleFS.remove(MANIFEST);
  LittleFS.mkdir(LIVE);
  bool ok = true;
  for (int i = 0; i < staged; ++i)
    ok = LittleFS.rename(String(STAGE) + '/' + names[i], String(LIVE) + '/' + names[i]) && ok;
  // Files an older version had and this one does not.
  String old[BundleReader::MAX_FILES + 4];
  int n = 0;
  Dir d = LittleFS.openDir(LIVE);
  while (n < (int)(sizeof(old) / sizeof(old[0])) && d.next()) {
    bool kept = false;
    for (int i = 0; i < staged && !kept; ++i) kept = names[i] == d.fileName();
    if (!kept) old[n++] = d.fileName();
  }
  for (int i = 0; i < n; ++i) LittleFS.remove(String(LIVE) + '/' + old[i]);
  LittleFS.rmdir(STAGE);
  if (!ok) return false;
  File m = LittleFS.open(MANIFEST, "w");
  char hex[9];
  snprintf_P(hex, sizeof(hex), PSTR("%08x"), (unsigned)bundle->hash);
  return m && m.print(hex) == 8;
}
}  // namespace

void updateFail(const String& why) {
  if (!failed) error = why;
  failed = true;
  if (Update.isRunning()) Update.end(false);
  started = false;
  if (out) out.close();
  clearStage();
  release();
}

void updateBegin() {
  if (Update.isRunning()) Update.end(false);
  release();
  clearStage();
  active = true; started = failed = false; first = true; skipFiles = false;
  staged = 0; received = 0;
  error = ""; note = "";
  firmware = new (std::nothrow) FirmwareValidation;
  if (!firmware) updateFail(F("Not enough memory for an update: try again"));
}

bool updateFeed(const uint8_t* data, size_t n) {
  if (failed || !active) return false;
  received += n;
  if (first && n) {
    first = false;
    if (BundleReader::isBundle(data, n)) {
      bundle = new (std::nothrow) BundleReader;
      if (!bundle) { updateFail(F("Not enough memory for an update: try again")); return false; }
      // Recovery leaves storage alone, and a storage that did not mount cannot take
      // files: the image installs, and the update file is installed again later.
      skipFiles = !storageReady || recoveryMode;
    }
  }
  return bundle ? bundleFeed(data, n) : imageFeed(data, n);
}

bool updateFinish() {
  if (failed || !active) return false;
  if (!started || !firmware->complete() || (bundle && !bundle->inImage())) {
    updateFail(F("Incomplete image or CRC mismatch")); return false;
  }
  if (Update.write(&firmware->lastByte, 1) != 1 || !Update.end(false)) {
    updateFail(F("Firmware commit failed")); return false;
  }
  started = false;
  if (bundle && skipFiles) note = F("The firmware is installed, not its files (storage not in use): install the .update file again after the restart");
  else if (bundle && !installFiles()) note = F("The firmware is installed, its files only in part: install the .update file again after the restart");
  release();
  active = false;
  return true;
}

const String& updateError() { return error; }
const String& updateNote() { return note; }
bool updateBusy() { return active && !failed; }
uint32_t updateReceived() { return received; }

// ---------------------------- POST /update_ota ------------------------------
namespace {
unsigned uploads = 0;
}

void handleOtaUpload() {
  HTTPUpload& up = server.upload();
  if (up.status == UPLOAD_FILE_START) {
    if (!requestAuthorized()) { error = ""; failed = false; updateFail(F("Sign in first")); return; }
    if (++uploads != 1) { updateFail(F("Upload exactly one firmware image")); return; }
    updateBegin();
  } else if (up.status == UPLOAD_FILE_WRITE) {
    updateFeed(up.buf, up.currentSize);
  } else if (up.status == UPLOAD_FILE_ABORTED) {
    updateFail(F("Upload aborted"));
    // The parser may not call the response handler for a disconnected client.
    uploads = 0;
    active = failed = false;
  }
  yield();
}

void finishOta() {
  bool ok = uploads == 1 && updateFinish();
  String reply = ok ? (note.length() ? String(F("OK: ")) + note : String(F("OK")))
                    : (error.length() ? error : String(F("No complete firmware uploaded")));
  server.sendHeader(F("Connection"), F("close"));
  server.send(ok ? 200 : 400, "text/plain", reply);
  uploads = 0;
  active = failed = false;
  error = "";
  release();
  if (ok) safeRestart();
}

// ---------------------------- /sys/manifest ---------------------------------
void filesCheck() {
  if (!storageReady || recoveryMode) { files = FILES_UNMOUNTED; return; }
  File m = LittleFS.open(MANIFEST, "r");
  if (!m) { files = FILES_MISSING; return; }
  char hex[9] = {};
  m.readBytes(hex, 8);
  char want[9];
  snprintf_P(want, sizeof(want), PSTR("%08x"), (unsigned)FILES_HASH);
  files = strcmp(hex, want) ? FILES_STALE : FILES_OK;
}
const __FlashStringHelper* filesState() {
  return files == FILES_OK ? F("ok") : files == FILES_STALE ? F("stale") : files == FILES_MISSING ? F("missing") : F("unmounted");
}
bool filesOk() { return files == FILES_OK; }
